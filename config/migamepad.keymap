#include <behaviors.dtsi>
#include <dt-bindings/zmk/keys.h>

/ {
    keymap {
        compatible = "zmk,keymap";

        layer_0 {
            label = "Base";
            bindings = <
&kp Q  &kp L  &kp R  &kp P  &kp UP_ARROW  &kp X  &kp LEFT  &kp RIGHT  &kp Y  &kp A  &kp DOWN  &kp B  &kp C  &kp S  &kp F1  &kp F2  &kp F3  &kp L
            >;
        };
    };
};
