## config/boards/shields/migamepad/Kconfig.defconfig
```kconfig
if SHIELD_MIGamePad

config ZMK_KEYBOARD_NAME
    default "MIGamePad"

config ZMK_BLE
    def_bool n

config SETTINGS
    def_bool n

endif
```
